## firmware/sonos-desk/sdkconfig.defaults
```kconfig
CONFIG_IDF_TARGET="esp32c6"
CONFIG_ESP_CONSOLE_USB_SERIAL_JTAG=y
CONFIG_ESP_CONSOLE_SECONDARY_NONE=y
CONFIG_FREERTOS_HZ=1000
CONFIG_MQTT_PROTOCOL_5=y
CONFIG_ESPTOOLPY_FLASHSIZE_8MB=y
CONFIG_MQTT_USE_CUSTOM_CONFIG=y
CONFIG_MQTT_SKIP_PUBLISH_IF_DISCONNECTED=y
CONFIG_MQTT_OUTBOX_EXPIRED_TIMEOUT_MS=5000
```
